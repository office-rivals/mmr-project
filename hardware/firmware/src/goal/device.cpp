#include "device.h"

#include <Preferences.h>
#include <WiFi.h>
#include <Wire.h>
#include <driver/gpio.h>
#include <driver/rtc_io.h>
#include <ulp_lp_core.h>
#include <esp_mac.h>
#include <esp_pm.h>
#include <esp_random.h>
#include <esp_rtc_time.h>
#include <esp_sleep.h>

#include "api.h"
#include "board.h"
#include "lp_blink.h"  // generated by tools/lp_build.py

#if __has_include("secrets.h")
#include "secrets.h"
#else
#warning "include/secrets.h missing - building with secrets.example.h placeholders"
#include "secrets.example.h"
#endif

namespace dev {

// Wi-Fi fast reconnect: remember AP channel/BSSID across deep sleep (skips the scan).
RTC_DATA_ATTR static uint8_t rtcBssid[6];
RTC_DATA_ATTR static int32_t rtcChannel = 0;
static bool synced = false, motion_init = false;
static std::string secret;  // device secret (§11), from NVS; never logged

// ---- NVS

struct NvsKv : Kv {
  Preferences p;
  bool open = false;
  Preferences& prefs() {
    if (!open) open = p.begin("fb", false);
    return p;
  }
  bool getU32(const char* k, uint32_t& o) override {
    if (!prefs().isKey(k)) return false;
    o = p.getUInt(k);
    return true;
  }
  bool setU32(const char* k, uint32_t v) override { return prefs().putUInt(k, v) == sizeof v; }
  bool getBlob(const char* k, void* b, size_t n) override { return prefs().getBytes(k, b, n) == n; }
  bool setBlob(const char* k, const void* b, size_t n) override { return prefs().putBytes(k, b, n) == n; }
  bool getStr(const char* k, std::string& o) override {
    if (!prefs().isKey(k)) return false;
    o = p.getString(k).c_str();
    return true;
  }
  bool setStr(const char* k, const std::string& v) override { return prefs().putString(k, v.c_str()) == v.size(); }
  void remove(const char* k) override { prefs().remove(k); }
};
static NvsKv nvs;

// ---- boot helpers

void pmInit(bool light_sleep) {
  esp_pm_config_t pm = {.max_freq_mhz = 160, .min_freq_mhz = 40, .light_sleep_enable = light_sleep};
  if (esp_pm_configure(&pm) != ESP_OK) Serial.println("esp_pm_configure failed - built without the custom sdkconfig?");
}

uint32_t buildId() {  // FNV-1a of version + build time
  const char* s = FW_VERSION " " __DATE__ " " __TIME__;
  uint32_t h = 2166136261u;
  while (*s) h = (h ^ (uint8_t)*s++) * 16777619u;
  return h;
}

// ---- LIS3DH: 10 Hz low-power (~4 uA), high-pass filtered so gravity and tilt don't count, INT1
// latched until INT1_SRC is read. Powered 24/7; configured once per boot.

static uint8_t lisAddr = LIS3DH_ADDR;  // clone boards strap SDO the other way: 0x18 / 0x19, found at boot

static uint8_t lisRead(uint8_t r) {
  Wire.beginTransmission(lisAddr);
  Wire.write(r);
  Wire.endTransmission(false);
  Wire.requestFrom(lisAddr, (uint8_t)1);
  return Wire.read();
}

// WHO_AM_I (0x0F) at `a`, -1 if nothing acknowledges.
static int whoAmI(uint8_t a) {
  Wire.beginTransmission(a);
  Wire.write(0x0F);
  if (Wire.endTransmission(false) != 0 || Wire.requestFrom(a, (uint8_t)1) != 1) return -1;
  return Wire.read();
}

void motionInit() {
  pinMode(PIN_MOTION_INT, INPUT);
  gpio_sleep_sel_dis((gpio_num_t)PIN_MOTION_INT);
  Wire.begin(PIN_I2C_SDA, PIN_I2C_SCL);
  motion_init = true;
  bool found = false, other = false;
  for (uint8_t a : {(uint8_t)LIS3DH_ADDR, (uint8_t)(LIS3DH_ADDR ^ 1)}) {
    int id = whoAmI(lisAddr = a);
    if ((found = id == 0x33)) break;  // LIS3DH
    other |= id >= 0;
  }
  if (!found) {  // electronics: some clone listings ship a LIS3DSH (0x1D / 0x1E, WHO_AM_I 0x3F)
    bool dsh = other || whoAmI(0x1D) >= 0 || whoAmI(0x1E) >= 0;
    Serial.println(dsh ? "lis3dh: found LIS3DSH, not supported - motion wake will not work"
                       : "LIS3DH not responding at 0x18/0x19 - motion wake will not work");
    return;
  }
  auto reg = [](uint8_t r, uint8_t v) {
    Wire.beginTransmission(lisAddr);
    Wire.write(r);
    Wire.write(v);
    return Wire.endTransmission() == 0;
  };
  // 0x18 = SDO strapped low: disconnect the chip's SA0 pull-up so it doesn't fight that in sleep. At 0x19
  // the pull-up may be what sets the address: leave it (electronics).
  bool ok = (lisAddr != 0x18 || reg(0x1E, 0x90))     // CTRL_REG0: SDO_PU_DISC
            && reg(0x20, 0x2F)                        // CTRL_REG1: 10 Hz, low-power, XYZ on
            && reg(0x21, 0x01)                        // CTRL_REG2: high-pass on INT1
            && reg(0x22, 0x40)                        // CTRL_REG3: IA1 -> INT1
            && reg(0x23, 0x00)                        // CTRL_REG4: +-2 g (16 mg/LSB in low-power)
            && reg(0x24, 0x08)                        // CTRL_REG5: LIR_INT1, latch INT1
            && reg(0x32, MOTION_THRESHOLD_MG / 16)    // INT1_THS
            && reg(0x33, 0x00)                        // INT1_DURATION
            && reg(0x30, 0x2A);                       // INT1_CFG: X/Y/Z high, OR
  lisRead(0x26);  // REFERENCE: settles the high-pass filter
  lisRead(0x31);  // INT1_SRC: clears the latch that woke us
  if (!ok) Serial.printf("LIS3DH at 0x%02x not responding - motion wake will not work\n", lisAddr);
  else if (lisAddr != LIS3DH_ADDR) Serial.printf("LIS3DH at 0x%02x\n", lisAddr);
}

bool motionPinActive() { return digitalRead(PIN_MOTION_INT) == MOTION_ACTIVE_LEVEL; }

bool motionSeen() {
  if (!motion_init || !motionPinActive()) return false;
  lisRead(0x31);
  return true;
}

// ---- the status LED's LP-core program (src/lp/blink.c)

void lpBlink(uint8_t n) {
  if (PIN_STATUS_LED < 0) return;
  ulp_lp_core_stop();
  gpio_num_t pin = (gpio_num_t)PIN_STATUS_LED;
  if (!n) {
    rtc_gpio_deinit(pin);  // back to a plain GPIO, Hi-Z: both LEDs off
    pinMode(PIN_STATUS_LED, INPUT);
    return;
  }
  rtc_gpio_init(pin);  // LP IO: the LP core drives it in deep sleep
  rtc_gpio_set_direction(pin, RTC_GPIO_MODE_DISABLED);
  rtc_gpio_pullup_dis(pin);
  rtc_gpio_pulldown_dis(pin);
  ulp_lp_core_load_binary(LP_BLINK_BIN, sizeof LP_BLINK_BIN);
  *LP_blinks = n;
  *LP_blink_ms = LED_BLINK_MS;
  *LP_gap_ms = LED_GAP_MS;
  *LP_period_ms = LED_PERIOD_ASLEEP_S * 1000;
  ulp_lp_core_cfg_t cfg = {};
  cfg.wakeup_source = ULP_LP_CORE_WAKEUP_SOURCE_LP_TIMER;
  cfg.lp_timer_sleep_duration_us = 1000;  // first edge right away; then the program sets each next one
  if (ulp_lp_core_run(&cfg) != ESP_OK) Serial.println("lp core: not started - no status LED in deep sleep");
}

// ---- Wi-Fi

static void rfSwitch(bool on) {
  // Released, the board's pull-up turns the switch off (also through light and deep sleep).
  pinMode(PIN_RF_SWITCH, on ? OUTPUT : INPUT);
  if (on) digitalWrite(PIN_RF_SWITCH, LOW);
}

static void radioOff() {
  WiFi.disconnect(true);
  WiFi.mode(WIFI_OFF);
  rfSwitch(false);
}

// Associated power save: MAX_MODEM wakes every listen interval (IDF default 3 beacons, ~300 ms of
// downlink latency, fine for uplink-only goals); MIN_MODEM every DTIM.
static wifi_ps_type_t psType(bool stay) { return stay ? WIFI_PS_MAX_MODEM : WIFI_PS_MIN_MODEM; }

static volatile bool txLow = false;  // round 3: below the warn level (set by the app, read by the lane tasks)

// Connects (stats updated); on failure the radio is switched off again.
static bool connect(bool stay, app::WifiStats& st, std::mutex& mu) {
  rfSwitch(true);
  WiFi.persistent(false);  // don't rewrite credentials to flash on every connect
  WiFi.mode(WIFI_STA);
  WiFi.setTxPower(txLow ? WIFI_TX_POWER_LOW : WIFI_TX_POWER);
  WiFi.setSleep(psType(stay));
  for (int attempt = 0; attempt < 2; attempt++) {
    bool fast = attempt == 0 && rtcChannel > 0;
    WiFi.begin(WIFI_SSID, WIFI_PASSWORD, fast ? rtcChannel : 0, fast ? rtcBssid : nullptr);
    uint32_t t0 = ::millis();
    while (WiFi.status() != WL_CONNECTED && ::millis() - t0 < WIFI_TIMEOUT_MS) delay(20);
    if (WiFi.status() == WL_CONNECTED) {
      rtcChannel = WiFi.channel();
      memcpy(rtcBssid, WiFi.BSSID(), 6);
      std::lock_guard<std::mutex> l(mu);
      st.connects++;
      st.connect_ms = ::millis() - t0;
      st.rssi = WiFi.RSSI();
      return true;
    }
    WiFi.disconnect();
    {
      std::lock_guard<std::mutex> l(mu);
      st.failed_attempts++;
    }
    if (!fast) break;
    rtcChannel = 0;  // AP moved: fall back to a full scan
  }
  radioOff();  // a failed connect must not leave the radio scanning
  return false;
}

// §11: a 256-bit secret, created once (with the radio on, so esp_random() is a true RNG) and kept in NVS.
static void ensureSecret() {
  if (!secret.empty() || nvs.getStr("secret", secret)) return;
  uint8_t b[32];
  esp_fill_random(b, sizeof b);
  char hex[65];
  for (int i = 0; i < 32; i++) snprintf(hex + 2 * i, 3, "%02x", b[i]);
  secret = hex;
  nvs.setStr("secret", secret);
}

// ---- HTTP

int Http::request(const char* method, const std::string& path, const std::string& body, String* resp,
                  uint32_t timeout_ms) {
  bool api = auth_ == Auth::Api;
  std::string url = std::string(api ? API_BASE_URL : OTLP_ENDPOINT) + path;
  bool https = url.rfind("https://", 0) == 0;
  if (!init_) {
    if (https) tls_.setCACert(api ? API_ROOT_CA : OTLP_ROOT_CA);
    h_.setReuse(true);  // keep-alive: no TLS handshake per request while associated
    init_ = true;
  }
  int code = -1;
  for (int attempt = 0; attempt < 2; attempt++) {
    h_.setTimeout(timeout_ms);
    if (!h_.begin(https ? static_cast<NetworkClient&>(tls_) : plain_, url.c_str())) return -1;
    if (api) {  // §11 device auth; the enrolment token only matters while the device is unknown
      static std::string id = [] {
        uint8_t mac[6];
        esp_read_mac(mac, ESP_MAC_WIFI_STA);
        return api::deviceId(mac);
      }();
      h_.addHeader("X-Device-Id", id.c_str());
      h_.addHeader("Authorization", ("Device " + secret).c_str());
      h_.addHeader("X-Enrolment-Token", ENROLMENT_TOKEN);
    } else if (*OTLP_HEADER_NAME) {
      h_.addHeader(OTLP_HEADER_NAME, OTLP_HEADER_VALUE);
    }
    if (!body.empty()) h_.addHeader("Content-Type", "application/json");
    code = h_.sendRequest(method, (uint8_t*)body.data(), body.size());
    if (resp) *resp = code > 0 ? h_.getString() : String();
    h_.end();  // with reuse, keeps the connection open
    // A keep-alive connection the server already closed fails on send: retry once on a fresh one.
    if (code != HTTPC_ERROR_SEND_HEADER_FAILED && code != HTTPC_ERROR_SEND_PAYLOAD_FAILED &&
        code != HTTPC_ERROR_CONNECTION_LOST)
      break;
  }
  Serial.printf("%s %s -> %d\n", method, path.c_str(), code);
  return code;
}

// ---- DeviceHal

static DeviceHal* self;

void DeviceHal::begin() {
  self = this;
  app_task_ = xTaskGetCurrentTaskHandle();
  radioOff();  // releases the RF switch the board variant drives on at boot
  for (int l = 0; l < 2; l++) {
    lanes_[l] = xQueueCreate(4, sizeof(Req*));
    xTaskCreate(laneTask, l == 0 ? "rest" : "otlp", 12288, (void*)(intptr_t)l, 1, nullptr);
  }
}

app::WakeCause DeviceHal::wakeCause() {
  switch (esp_sleep_get_wakeup_cause()) {
    case ESP_SLEEP_WAKEUP_EXT1:
      if (PIN_VBUS_SENSE >= 0 && (esp_sleep_get_ext1_wakeup_status() & (1ULL << PIN_VBUS_SENSE))) return app::WakeCause::Usb;
      return PIN_UNDO >= 0 && (esp_sleep_get_ext1_wakeup_status() & (1ULL << PIN_UNDO)) ? app::WakeCause::Key
                                                                                        : app::WakeCause::Motion;
    case ESP_SLEEP_WAKEUP_TIMER:
      return app::WakeCause::Timer;
    default:
      return app::WakeCause::PowerOn;
  }
}

bool DeviceHal::ensureWifi() {
  static std::mutex wifi_mu;
  std::lock_guard<std::mutex> l(wifi_mu);
  if (WiFi.status() == WL_CONNECTED) return true;
  if (!connect(stay_, stats_, mu_)) return false;
  ensureSecret();
  if (!synced) {
    configTime(0, 0, NTP_SERVER);
    for (int i = 0; i < 30 && time(nullptr) < 1700000000; i++) delay(100);
    synced = time(nullptr) >= 1700000000;  // slow-clock drift in deep sleep: only this wake's sync counts
  }
  return true;
}

void DeviceHal::laneTask(void* arg) {
  int lane = (int)(intptr_t)arg;
  Http http(lane == (int)app::Lane::Otlp ? Http::Auth::Otlp : Http::Auth::Api);
  for (;;) {
    Req* r;
    xQueueReceive(self->lanes_[lane], &r, portMAX_DELAY);
    int code = -1;
    String body;
    if (self->ensureWifi()) code = http.request(r->method.c_str(), r->path, r->body, &body, r->timeout_ms);
    {
      std::lock_guard<std::mutex> l(self->mu_);
      self->results_.push_back({r->id, code, body.c_str()});
    }
    delete r;
    xTaskNotifyGive(self->app_task_);
  }
}

void DeviceHal::send(uint32_t id, app::Lane lane, const char* method, const std::string& path, const std::string& body,
                     uint32_t timeout_ms) {
  Req* r = new Req{id, method, path, body, timeout_ms};
  xQueueSend(lanes_[(int)lane], &r, portMAX_DELAY);  // the app keeps at most one request per lane in flight
}

void DeviceHal::deliver(app::GoalApp& a) {
  for (;;) {
    Res r;
    {
      std::lock_guard<std::mutex> l(mu_);
      if (results_.empty()) return;
      r = std::move(results_.front());
      results_.pop_front();
    }
    a.response(r.id, r.code, r.body);
  }
}

void DeviceHal::wait(uint32_t ms) { ulTaskNotifyTake(pdTRUE, ms == UINT32_MAX ? portMAX_DELAY : pdMS_TO_TICKS(ms)); }

void DeviceHal::notifyFromIsr() {
  BaseType_t woke = pdFALSE;
  vTaskNotifyGiveFromISR(app_task_, &woke);
  if (woke) portYIELD_FROM_ISR();
}

int64_t DeviceHal::epochMs() {
  if (!synced) return 0;
  struct timeval tv;
  gettimeofday(&tv, nullptr);
  return (int64_t)tv.tv_sec * 1000 + tv.tv_usec / 1000;
}

uint32_t DeviceHal::rtcSeconds() { return (uint32_t)(esp_rtc_get_time_us() / 1000000); }

int DeviceHal::batteryMv() {
  if (PIN_BATT_ADC < 0) return -1;
  static bool init = [] {
    analogSetPinAttenuation(PIN_BATT_ADC, ADC_11db);  // 12 dB: up to ~3.1 V at the pin
    return true;
  }();
  (void)init;
  uint32_t sum = 0;
  for (int i = 0; i < 8; i++) sum += analogReadMilliVolts(PIN_BATT_ADC);
  int mv = (int)(sum / 8 * BATT_DIVIDER);
  return mv < NO_PACK_MV ? -1 : mv;  // the divider taps the pack: ~0 V on USB power alone
}

Kv& DeviceHal::kv() { return nvs; }

std::string DeviceHal::deviceId() {
  uint8_t mac[6];
  esp_read_mac(mac, ESP_MAC_WIFI_STA);
  return api::deviceId(mac);
}

std::string DeviceHal::resetReason() {
  switch (esp_reset_reason()) {
    case ESP_RST_POWERON: return "poweron";
    case ESP_RST_EXT: return "ext";
    case ESP_RST_SW: return "sw";
    case ESP_RST_PANIC: return "panic";
    case ESP_RST_INT_WDT: return "int_wdt";
    case ESP_RST_TASK_WDT: return "task_wdt";
    case ESP_RST_WDT: return "wdt";
    case ESP_RST_DEEPSLEEP: return "deepsleep";
    case ESP_RST_BROWNOUT: return "brownout";
    case ESP_RST_USB: return "usb";
    case ESP_RST_JTAG: return "jtag";
    default: return "other";
  }
}

uint32_t DeviceHal::freeHeap() { return esp_get_free_heap_size(); }
uint32_t DeviceHal::minFreeHeap() { return esp_get_minimum_free_heap_size(); }
bool DeviceHal::otlpEnabled() { return *OTLP_ENDPOINT; }

void DeviceHal::wifiOff() { radioOff(); }

void DeviceHal::wifiTxLow(bool low) {
  if (low == txLow) return;
  txLow = low;
  Serial.printf("wifi: TX power %s\n", low ? "low (battery low)" : "normal");
  if (WiFi.getMode() == WIFI_STA) WiFi.setTxPower(low ? WIFI_TX_POWER_LOW : WIFI_TX_POWER);
}

app::WifiStats DeviceHal::wifiStats() {
  std::lock_guard<std::mutex> l(mu_);
  return stats_;
}

void DeviceHal::led(bool on) {
  if (PIN_LED < 0) return;
  if (!led_init_) pinMode(PIN_LED, OUTPUT), led_init_ = true;
  digitalWrite(PIN_LED, on ? LED_ON_LEVEL : !LED_ON_LEVEL);
}

bool DeviceHal::usbPowered() {  // only called once the strap confirmed the board (GoalApp::boot)
  if (PIN_VBUS_SENSE < 0) return false;
  static bool init = (pinMode(PIN_VBUS_SENSE, INPUT), true);  // the divider's 100k holds it LOW on battery
  (void)init;
  return digitalRead(PIN_VBUS_SENSE);
}

void DeviceHal::lightSleep(bool allowed) { pmInit(allowed && USE_LIGHT_SLEEP); }

static constexpr uint8_t BUZZER_BITS = 13;  // 0.01 % duty steps; 3.5 kHz x 2^13 is well under the LEDC clock

void DeviceHal::buzzerInit(int pin) {
  if (pin < 0) return;
  ledcAttach(pin, 2048, BUZZER_BITS);
  ledcWrite(pin, 0);  // LOW = coil off (and the base pull-down while not driven)
  esp_pm_lock_create(ESP_PM_CPU_FREQ_MAX, 0, "tone", (esp_pm_lock_handle_t*)&tone_lock_);
  buzzer_pin_ = pin;
}

// While it sounds: no light sleep and no DFS (the LEDC clock would stop or shift, and a pin frozen HIGH
// holds the coil on). The app updates the duty every ~1 ms (ux's envelopes); 0 = pin LOW, never driven.
void DeviceHal::tone(uint32_t hz, int duty_bp) {
  if (buzzer_pin_ < 0) return;
  bool on = hz && duty_bp > 0;
  if (on) {
    if (!sounding_) esp_pm_lock_acquire((esp_pm_lock_handle_t)tone_lock_);
    if (hz != tone_hz_) ledcChangeFrequency(buzzer_pin_, tone_hz_ = hz, BUZZER_BITS);
    ledcWrite(buzzer_pin_, (uint32_t)((uint64_t)((1u << BUZZER_BITS) - 1) * duty_bp / 10000));
  } else {
    ledcWrite(buzzer_pin_, 0);
    tone_hz_ = 0;
    if (sounding_) esp_pm_lock_release((esp_pm_lock_handle_t)tone_lock_);
  }
  sounding_ = on;
}

void DeviceHal::deepSleep(const app::SleepRequest& r) {
  radioOff();
  lpBlink(r.blinks);
  esp_sleep_disable_wakeup_source(ESP_SLEEP_WAKEUP_ALL);
  uint32_t timer = r.timer_s;
  if (!motion_init) motionInit();  // heartbeat wakes don't init the board; the latch still needs clearing
  motionSeen();                    // clear the latch so ext1 waits for new motion
  if (motionPinActive()) {
    timer = timer && timer < tel::STUCK_RECHECK_S ? timer : tel::STUCK_RECHECK_S;  // stuck: don't wake-loop
  } else {
    esp_sleep_enable_ext1_wakeup_io(1ULL << PIN_MOTION_INT,
                                    MOTION_ACTIVE_LEVEL ? ESP_EXT1_WAKEUP_ANY_HIGH : ESP_EXT1_WAKEUP_ANY_LOW);
  }
  if (PIN_VBUS_SENSE >= 0) {  // plugging USB in wakes it
    // review 2 O-N1: MTCK comes out of reset with its pull-up on; in sleep it would sit against the divider
    rtc_gpio_pullup_dis((gpio_num_t)PIN_VBUS_SENSE);
    rtc_gpio_pulldown_dis((gpio_num_t)PIN_VBUS_SENSE);
    esp_sleep_enable_ext1_wakeup_io(1ULL << PIN_VBUS_SENSE, ESP_EXT1_WAKEUP_ANY_HIGH);
  }
  if (PIN_UNDO >= 0) {
    pinMode(PIN_UNDO, INPUT);  // external pull-up (a heartbeat wake never ran boardInit)
    if (digitalRead(PIN_UNDO) == LOW)  // held or stuck: a level wake would loop; look again later
      timer = timer && timer < tel::STUCK_RECHECK_S ? timer : tel::STUCK_RECHECK_S;
    else
      esp_sleep_enable_ext1_wakeup_io(1ULL << PIN_UNDO, ESP_EXT1_WAKEUP_ANY_LOW);  // C6: per-pin levels
  }
  if (timer) esp_sleep_enable_timer_wakeup((uint64_t)timer * 1000000);
  Serial.flush();
  esp_deep_sleep_start();
}

}  // namespace dev
